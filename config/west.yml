## config/west.yml
```yaml
manifest:
  remotes:
    - name: zmkfirmware
      url-base: https://github.com/zmkfirmware
    - name: armastardo
      url-base: https://github.com/Armastardo
  projects:
    - name: zmk
      remote: zmkfirmware
      revision: v0.3
      import: app/west.yml
    - name: bault-zmk-config
      remote: armastardo
      revision: v0.3
  self:
    path: config
```
